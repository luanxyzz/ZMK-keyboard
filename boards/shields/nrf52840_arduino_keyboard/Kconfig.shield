## boards/shields/nrf52840_arduino_keyboard/Kconfig.shield
```kconfig
config SHIELD_NRF52840_ARDUINO_KEYBOARD
    def_bool $(shields_list_contains,nrf52840_arduino_keyboard)
```

## config/boards/shields/nrf52840_arduino_keyboard/Kconfig.defconfig
```kconfig
if SHIELD_NRF52840_ARDUINO_KEYBOARD

config ZMK_KEYBOARD_NAME
    default "ZMK Keypad"

endif
```
